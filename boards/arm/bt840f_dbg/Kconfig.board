## boards/arm/bt840f_dbg/Kconfig.board
```kconfig
# Kconfig - nRF52840 BT840F module

config BOARD_BT840F_DBG
	bool "bt840f module for debug"
	depends on SOC_NRF52840_QIAA
```

## boards/arm/bt840f_dbg/Kconfig.defconfig
```kconfig
# Kconfig - nRF52840 BT840F module for Debug

if BOARD_BT840F_DBG

config BOARD
	default "bt840f_dbg"

config BT_CTLR
	default BT

config NRFX_UARTE0
    default y

config NRFX_UARTE1
    default y

endif
```

## boards/arm/nrf52_modul/Kconfig.board
```kconfig
# Kconfig - nRF52 BLENANO 2 board configuration
#
# Copyright (c) 2016 Linaro Limited.
#
# SPDX-License-Identifier: Apache-2.0


config BOARD_NRF52_MODUL
	bool "nRF52 MODUL"
	depends on SOC_NRF52832_QFAA
```

## boards/arm/nrf52_modul/Kconfig.defconfig
```kconfig
# Kconfig - nRF52 BLENANO 2 board configuration
#
# Copyright (c) 2016 Nordic Semiconductor ASA
#
# SPDX-License-Identifier: Apache-2.0

if BOARD_NRF52_MODUL

config BOARD
	default "nrf52_modul"

config BT_CTLR
	default BT

endif
```
